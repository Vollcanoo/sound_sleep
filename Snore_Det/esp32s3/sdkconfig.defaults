## Snore_Det/esp32s3/sdkconfig.defaults
```kconfig
CONFIG_ESP32S3_SPIRAM_SUPPORT=y
CONFIG_SPIRAM_MODE_OCT=y
CONFIG_SPIRAM_SPEED_80M=y
CONFIG_SPIRAM_USE_CAPS_ALLOC=y
CONFIG_ESP32S3_DEFAULT_CPU_FREQ_240=y
CONFIG_DSP_MAX_FFT_SIZE=1024
CONFIG_SNORE_I2S_BCLK_GPIO=16
CONFIG_SNORE_I2S_WS_GPIO=15
CONFIG_SNORE_I2S_DOUT_GPIO=17
CONFIG_SNORE_I2S_USE_RIGHT_CHANNEL=y
CONFIG_ESPTOOLPY_FLASHSIZE_8MB=y
CONFIG_PARTITION_TABLE_CUSTOM=y
CONFIG_PARTITION_TABLE_CUSTOM_FILENAME="partitions.csv"
```

## main/Kconfig.projbuild
```kconfig
menu "Snoring detector"

config SNORE_I2S_BCLK_GPIO
    int "INMP441 BCLK/SCK GPIO"
    default 16

config SNORE_I2S_WS_GPIO
    int "INMP441 WS/LRCLK GPIO"
    default 15

config SNORE_I2S_DOUT_GPIO
    int "INMP441 SD/DOUT GPIO"
    default 17

config SNORE_I2S_USE_RIGHT_CHANNEL
    bool "Read right I2S channel"
    default y

endmenu

menu "Pillow airbag bench test"

config PUMP_BENCH_TEST
    bool "Build airbag bench-test firmware"
    default n
    help
        Build a minimal firmware for verifying the airbag GPIO outputs. It
        starts only the serial command task and pump controller; Wi-Fi, BLE,
        sensors, cloud clients, and sleep-control tasks are excluded.

endmenu
```

## sdkconfig.defaults
```kconfig
# ESP-IDF v5.5.2
CONFIG_ESP_TLS_USING_MBEDTLS=y
CONFIG_MBEDTLS_CERTIFICATE_BUNDLE=y
CONFIG_MBEDTLS_CERTIFICATE_BUNDLE_DEFAULT_FULL=y
CONFIG_ESP_MAIN_TASK_STACK_SIZE=8192
CONFIG_FREERTOS_TIMER_TASK_STACK_DEPTH=4096
CONFIG_LOG_DEFAULT_LEVEL_INFO=y
CONFIG_PARTITION_TABLE_CUSTOM=y
CONFIG_PARTITION_TABLE_CUSTOM_FILENAME="partitions.csv"
CONFIG_ESPTOOLPY_FLASHSIZE_8MB=y
CONFIG_ESP32S3_SPIRAM_SUPPORT=y
CONFIG_SPIRAM_MODE_OCT=y
CONFIG_SPIRAM_SPEED_80M=y
CONFIG_SPIRAM_USE_CAPS_ALLOC=y
CONFIG_DSP_MAX_FFT_SIZE=1024
CONFIG_SNORE_I2S_BCLK_GPIO=16
CONFIG_SNORE_I2S_WS_GPIO=15
CONFIG_SNORE_I2S_DOUT_GPIO=17
CONFIG_SNORE_I2S_USE_RIGHT_CHANNEL=y

# BLE (NimBLE) — 对接 frontier 分支 Flutter App
CONFIG_BT_ENABLED=y
CONFIG_BT_NIMBLE_ENABLED=y
CONFIG_BT_NIMBLE_MAX_CONNECTIONS=1
CONFIG_BT_NIMBLE_ROLE_PERIPHERAL=y
CONFIG_BT_NIMBLE_ROLE_CENTRAL=n
CONFIG_BT_NIMBLE_ROLE_OBSERVER=n
CONFIG_BT_NIMBLE_ROLE_BROADCASTER=y

# WiFi + BLE 共存仲裁
CONFIG_SW_COEXIST_ENABLE=y
CONFIG_ESP_COEX_SW_COEXIST_ENABLE=y
```
